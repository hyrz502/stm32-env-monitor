/**
  ******************************************************************************
  * @file    bsp_oled.c
  * @brief   0.96" OLED（SSD1315/SSD1306，I2C1）驱动。
  ******************************************************************************
  */
#include "bsp_oled.h"
#include "main.h"
#include "i2c.h"
#include <string.h>

/* 全屏显存：8 页 x 128 列 */
static uint8_t GRAM[8][128];

void OLED_SendCmd(uint8_t cmd)
{
  uint8_t buf[2];
  buf[0] = 0x00; /* 控制字节: Co=0, D/C=0 -> 后续为命令 */
  buf[1] = cmd;
  HAL_I2C_Master_Transmit(&hi2c1, OLED_ADDRESS, buf, sizeof(buf), HAL_MAX_DELAY);
}

void OLED_Init(void)
{
  HAL_Delay(20);

  OLED_SendCmd(0xAE); /* 关闭显示 */
  OLED_SendCmd(0x20); /* 内存寻址模式 */
  OLED_SendCmd(0x10); /* 页寻址模式（ShowFrame 依赖） */
  OLED_SendCmd(0x40); /* 显示起始行 = 0 */
  OLED_SendCmd(0xA1); /* 段重映射: 列127 -> SEG0 */
  OLED_SendCmd(0xC8); /* COM 扫描方向: COM63 -> COM0 */
  OLED_SendCmd(0x81); /* 对比度 */
  OLED_SendCmd(0xCF);
  OLED_SendCmd(0xA6); /* 正常显示 */
  OLED_SendCmd(0xA8); /* 复用比 */
  OLED_SendCmd(0x3F); /* 64 行 */
  OLED_SendCmd(0xA4); /* 按 GDDRAM 内容显示 */
  OLED_SendCmd(0xD3); /* 显示偏移 */
  OLED_SendCmd(0x00);
  OLED_SendCmd(0xD5); /* 时钟分频/振荡器频率 */
  OLED_SendCmd(0x80);
  OLED_SendCmd(0xD9); /* 预充电周期 */
  OLED_SendCmd(0xF1);
  OLED_SendCmd(0xDA); /* COM 引脚硬件配置 */
  OLED_SendCmd(0x12); /* 顺序 COM 配置 */
  OLED_SendCmd(0xDB); /* VCOMH 电压 */
  OLED_SendCmd(0x40);
  OLED_SendCmd(0x8D); /* 电荷泵 */
  OLED_SendCmd(0x14); /* 开启电荷泵 */
  OLED_SendCmd(0xAF); /* 开启显示 */
}

void OLED_NewFrame(void)
{
  memset(GRAM, 0, sizeof(GRAM));
}

void OLED_ShowFrame(void)
{
  uint8_t buf[129];
  uint8_t page, col;

  buf[0] = 0x40; /* 控制字节: Co=0, D/C=1 -> 后续为显存数据 */
  for (page = 0; page < 8; page++)
  {
    for (col = 0; col < 128; col++)
    {
      buf[col + 1] = GRAM[page][col];
    }
    OLED_SendCmd(0xB0 + page); /* 页地址 */
    OLED_SendCmd(0x00);        /* 列地址低 4 位 */
    OLED_SendCmd(0x10);        /* 列地址高 4 位 */
    HAL_I2C_Master_Transmit(&hi2c1, OLED_ADDRESS, buf, sizeof(buf), HAL_MAX_DELAY);
  }
}

/**
  * @brief  点亮一个像素。
  * @param  x: 0~127, y: 0~63
  */
void OLED_SetPixel(uint8_t x, uint8_t y)
{
  if (x >= 128 || y >= 64)
  {
    return;
  }
  GRAM[y / 8][x] |= (uint8_t)(0x01U << (y % 8));
}

/* 标准 6x8 ASCII 字库 (ASCII 32~127, 每个字符 6 字节, 末列为间距) */
static const uint8_t Font6x8[][6] = {
  {0x00,0x00,0x00,0x00,0x00,0x00}, /*   */
  {0x00,0x00,0x5F,0x00,0x00,0x00}, /* ! */
  {0x00,0x07,0x00,0x07,0x00,0x00}, /* " */
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  {0x02,0x01,0x02,0x01,0x00,0x00}, /* ~ */
};

/**
  * @brief  显示字符（6x8）。
  * @param  column: 字符列 0~20; page: 页 0~7
  */
void OLED_ShowChar(uint8_t column, uint8_t page, char ch)
{
  uint8_t x = (uint8_t)(column * 6);
  uint8_t idx;

  if (ch < 32 || ch > 126)
  {
    return;
  }
  if (page > 7 || (x + 6) > 128)
  {
    return;
  }
  idx = (uint8_t)(ch - 32);
  for (uint8_t i = 0; i < 6; i++)
  {
    GRAM[page][x + i] = Font6x8[idx][i];
  }
}

/**
  * @brief  显示字符串（6x8），超宽自动换行。
  */
void OLED_ShowString(uint8_t column, uint8_t page, const char *str)
{
  uint8_t x = (uint8_t)(column * 6);

  while (*str)
  {
    if ((x + 6) > 128)
    {
      x = 0;
      page++;
      if (page > 7)
      {
        return;
      }
    }
    OLED_ShowChar((uint8_t)(x / 6), page, *str);
    x += 6;
    str++;
  }
}

static uint16_t Pow10(uint16_t exp)
{
  uint16_t r = 1;
  while (exp--)
  {
    r *= 10;
  }
  return r;
}

/**
  * @brief  显示无符号整数（定宽，左端补 0）。
  * @param  column: 起始字符列; page: 页; num: 数值; len: 位数
  */
void OLED_ShowNum(uint16_t column, uint16_t page, uint32_t num, uint8_t len)
{
  for (uint8_t i = 0; i < len; i++)
  {
    OLED_ShowChar((uint8_t)(column + i), (uint8_t)page,
                  (char)((num / Pow10((uint16_t)(len - 1 - i))) % 10 + '0'));
  }
}
