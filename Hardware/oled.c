#include "oled.h"
#include <string.h>

uint8_t GRAM[8][128];

void OLED_SendCmd(uint8_t cmd)
{
	uint8_t oled_Cmdbuf[2];
	oled_Cmdbuf[0]=0x00;
	oled_Cmdbuf[1]=cmd;
	HAL_I2C_Master_Transmit(&hi2c1,OLED_ADDRESS,oled_Cmdbuf,sizeof(oled_Cmdbuf),HAL_MAX_DELAY);
}


void OLED_Init(void)
{
  HAL_Delay(20);

  OLED_SendCmd(0xAE); // 关闭显示

  OLED_SendCmd(0x20); // 内存寻址模式
  OLED_SendCmd(0x10); // 10 = 页寻址模式 (ShowFrame 依赖此模式)

  OLED_SendCmd(0x40); // 显示起始行 = 0

  OLED_SendCmd(0xA1); // 段重映射: 列127映射到SEG0 (模块正常方向)
  OLED_SendCmd(0xC8); // COM扫描方向: 从COM63到COM0 (上下不翻转)

  OLED_SendCmd(0x81); // 设置对比度
  OLED_SendCmd(0xCF); // 0xCF, 值越大越亮

  OLED_SendCmd(0xA6); // 正常显示 (1=点亮)
  OLED_SendCmd(0xA8); // 设置复用比
  OLED_SendCmd(0x3F); // 64行 (MUX-1 = 63)

  OLED_SendCmd(0xA4); // 按GDDRAM内容显示

  OLED_SendCmd(0xD3); // 显示偏移
  OLED_SendCmd(0x00); // 偏移 = 0

  OLED_SendCmd(0xD5); // 时钟分频/振荡器频率
  OLED_SendCmd(0x80); // 高4位振荡频率, 低4位分频比

  OLED_SendCmd(0xD9); // 预充电周期
  OLED_SendCmd(0xF1); // 高4位Phase2, 低4位Phase1

  OLED_SendCmd(0xDA); // COM引脚硬件配置
  OLED_SendCmd(0x12); // 0x12 = 顺序COM配置 (128x64常用)

  OLED_SendCmd(0xDB); // VCOMH电压
  OLED_SendCmd(0x40); // ~0.77 * Vcc

  OLED_SendCmd(0x8D); // 电荷泵设置
  OLED_SendCmd(0x14); // 开启电荷泵 (SSD1315: 0x14)

  OLED_SendCmd(0xAF); // 开启显示
  
}


void OLED_NewFrame(void)
{
	memset(GRAM,0,sizeof(GRAM));
}
void OLED_ShowFrame(void)
{
	uint8_t buffer[129];
	buffer[0]=0x40;
	for(uint8_t i=0;i<8;i++)
	{
		for(uint8_t j=0;j<128;j++)
		{
			buffer[j+1]=GRAM[i][j];
		}
		OLED_SendCmd(0xB0+i);
		OLED_SendCmd(0x00);
		OLED_SendCmd(0x10);
		HAL_I2C_Master_Transmit(&hi2c1,OLED_ADDRESS,buffer,sizeof(buffer),HAL_MAX_DELAY);
	}
}

/*************************************************************
*(0,0)------------------->(x)
*|
*|
*|
*|
*|
*|
*|
*|
*v(y)

@brief    :x(0~127),y(0~64)
*************************************************************/
void OLED_SetPixel(uint8_t x,uint8_t y)
{
	if(x>=128||y>=64) return;
	GRAM[y/8][x] |=0x01<<(y%8);
}

/* 标准6x8 ASCII字库 (ASCII 32~127, 每个字符6字节, 末列为间距) */
static const uint8_t OLED_Font6x8[][6] = {
	{0x00,0x00,0x00,0x00,0x00,0x00}, /* 32  ' ' */
	{0x00,0x00,0x5F,0x00,0x00,0x00}, /* 33  '!' */
	{0x00,0x07,0x00,0x07,0x00,0x00}, /* 34  '"' */
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	{0x02,0x01,0x02,0x01,0x00,0x00}, /* 126 '~' */
};

/******************************************************************************
功能：显示字符（6x8）
参数：列（0~20）
参数：上下方向页（0~7）
******************************************************************************/
void OLED_ShowChar(uint8_t column, uint8_t page, char ch)
{
	uint8_t x=column*6;
	if (ch < 32 || ch > 126) return;
	if (page > 7 || x + 6 > 128) return;

	uint8_t idx = ch - 32;
	for (uint8_t i = 0; i < 6; i++)
	{
		GRAM[page][x + i] = OLED_Font6x8[idx][i];
	}
}

/******************************************************************************
功能：显示字符串(6x8)
参数：列（0~20）
参数：上下方向页（0~7）
******************************************************************************/
void OLED_ShowString(uint8_t column, uint8_t page, const char *str)
{
	uint8_t x = column*6;
	while (*str)
	{
		if (x + 6 > 128)
		{
			x = 0;
			page++;
			if (page > 7) return;
		}
		OLED_ShowChar(x/6, page, *str);
		x += 6;
		str++;
	}
}

uint16_t Pow(uint16_t x,uint16_t y)
{
	uint16_t result=1;
	while(y--)
	{
		result*=x;
	}
	return result;
}

/******************************************************************************
功能：显示数字（0~4,294,967,295）(6x8)
参数：列（0~20）
参数：上下方向页（0~7）
******************************************************************************/
void OLED_ShowNum(uint16_t Column,uint16_t Page,uint32_t num,uint8_t len)
{
	
	for(uint8_t i=0;i<len;i++)
	{
		OLED_ShowChar(Column+i,Page,num/(Pow(10,len-1-i))%10+'0');
	}
}

